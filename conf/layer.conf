## conf/layer.conf
```bitbake
# We have a conf and classes directory, add to BBPATH
BBPATH .= ":${LAYERDIR}"

# We have recipes-* directories, add to BBFILES
BBFILES += "${LAYERDIR}/recipes-*/*/*.bb \
            ${LAYERDIR}/recipes-*/*/*.bbappend"

BBFILE_COLLECTIONS += "meta-custom-button"
BBFILE_PATTERN_meta-custom-button = "^${LAYERDIR}/"
BBFILE_PRIORITY_meta-custom-button = "6"

LAYERDEPENDS_meta-custom-button = "core"
LAYERSERIES_COMPAT_meta-custom-button = "scarthgap mickledore"
```
